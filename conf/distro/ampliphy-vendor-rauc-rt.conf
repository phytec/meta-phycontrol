## conf/distro/ampliphy-vendor-rauc-rt.conf
```bitbake
require conf/distro/ampliphy-vendor-rt.conf

DISTRO = "ampliphy-vendor-rauc-rt"
DISTRO_NAME = "ampliPHY Vendor (Phytec Vendor Distribution + RAUC + Preempt-RT)"

require conf/distro/include/common-rauc.inc
```

## conf/machine/phycontrol-nova-imx8mp-1.conf
```bitbake
#@TYPE: Machine
#@NAME: phycontrol-nova-imx8mp-1
#@DESCRIPTION: PHYTEC phyCONTROL-Nova i.MX8M Plus
#@ARTICLENUMBERS: 

MACHINEOVERRIDES =. "mx8mp:"

require conf/machine/include/imx-base.inc
include conf/machine/include/phyimx8m.inc

MACHINE_FEATURES += "can"
MACHINE_FEATURES:append:use-nxp-bsp = " tpm2"

KERNEL_DEVICETREE = " \
        freescale/imx8mp-phycontrol-nova.dtb \
        freescale/imx8mp-phycore-no-eth.dtbo \
        freescale/imx8mp-phycore-no-rtc.dtbo \
        freescale/imx8mp-phycore-no-spiflash.dtbo \
        freescale/imx8mp-phycore-rpmsg.dtbo \
"

# Set DDR FIRMWARE
DDR_FIRMWARE_NAME = " \
	lpddr4_pmu_train_1d_dmem_202006.bin \
	lpddr4_pmu_train_1d_imem_202006.bin \
	lpddr4_pmu_train_2d_dmem_202006.bin \
	lpddr4_pmu_train_2d_imem_202006.bin \
"

UBOOT_CONFIG:use-nxp-bsp ??= "sd fspi"
UBOOT_CONFIG:use-mainline-bsp ??= "sd"
UBOOT_CONFIG[sd] = "phycore-imx8mp_defconfig,sdcard"
UBOOT_CONFIG[fspi] = "phycore-imx8mp_defconfig"
SPL_BINARY = "spl/u-boot-spl.bin"

# Set u-boot DTB
UBOOT_DTB_NAME = "imx8mp-phyboard-pollux-rdk.dtb"

ATF_PLATFORM = "imx8mp"
ATF_LOAD_ADDR = "0x970000"

# Set imx-mkimage boot target
IMXBOOT_TARGETS = "flash_evk flash_evk_flexspi"

# Set Serial console
SERIAL_CONSOLES = "115200;ttymxc0"

IMAGE_BOOTLOADER = "imx-boot"

KERNEL_IMAGETYPE = "Image"

LOADADDR = ""

UBOOT_SUFFIX = "bin"
UBOOT_MAKE_TARGET = "all"
```
